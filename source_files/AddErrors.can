/*@!Encoding:1252*/
includes
{
  
}

variables
{
  
}

int AddErrors(int sensor)
{
  //Goes through the ErrorSelectPanel and checks which bits to change
  //Each bit is changed as it's validated to get error injection
  //The comments next to the values notes which bit is changed
  if (getValue(NN_A))
    if (getValue(NN)) sensor |= 0x40; //0100 0000
    else sensor &= 0xBF;              //1011 1111
  if (getValue(UU_A))
    if (getValue(UU)) sensor |= 0x20; //0010 0000
    else sensor &= 0xDF;              //1101 1111
  if (getValue(N_A))
    if (getValue(N)) sensor |= 0x10;  //0001 0000
    else sensor &= 0xEF;              //1110 1111
  if (getValue(U_A)) 
    if (getValue(U)) sensor |= 0x08;  //0000 1000
    else sensor &= 0xF7;              //1111 0111
  if (getValue(C_A))
    if (getValue(C)) sensor |= 0x04;  //0000 0100
    else sensor &= 0xFB;              //1111 1011
  if (getValue(A_A))
    if (getValue(A)) sensor |= 0x02;  //0000 0010
    else sensor &= 0xFD;              //1111 1101
  if (getValue(M_A))
    if (getValue(M)) sensor |= 0x01;  //0000 0001
    else sensor &= 0xFE;              //1111 1110
  
  return sensor;
}