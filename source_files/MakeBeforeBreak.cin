/*@!Encoding:1252*/
includes
{
  #include "ChangeImages.cin"
}

variables
{
  int i = 0;
  int j = 0;
  int _last_position = 0x06; //Assume shifter begin in neutral
  int _last_move = 0x06;
  int _repeated = 0;
  int _sensors_active = 0;
  int _allowed = 0;
  int _non_adjacent_active = 0;
  int _matched_pattern = 0;
  int _found_error[5] = {0,0,0,0,0};
  int _legal_patterns[15][4] = 
  {
    /* 
    { {7:Not used}, {6:--}, {5:++}, {4:-}, {3:+}, {2:C}, {1-0:A-M} }
    bit 7: Not used
    bit 6: --
    bit 5: ++
    bit 4: -
    bit 3: +
    bit 2: C
    bit 1-0: A-M 
    */
    //Automatic shift
    { 0x42, 0x52 },
    { 0x52, 0x42, 0x12 },
    { 0x12, 0x52, 0x16 },
    { 0x16, 0x12, 0x06 },
    { 0x0E, 0x06, 0x0A },
    { 0x0A, 0x0E, 0x2A },
    { 0x2A, 0x0A, 0x22 },
    { 0x22, 0x2A },
    //Switching Automatic -> Manual
    { 0x06, 0x16, 0x0E, 0x07 },
    { 0x07, 0x05, 0x06 },
    { 0x05, 0x0D, 0x15, 0x07 },
    //Manual shift
    { 0x15, 0x05, 0x11 },
    { 0x11, 0x15 }, 
    { 0x0D, 0x09, 0x05 },
    { 0x09, 0x0D }
  };
  
  char bits[16][5] = {"0000","0001","0010","0011","0100","0101","0110","0111","1000","1001","1010","1011","1100","1101","1110","1111"};
}

//Returns 1 if a non-adjacent sensor is active
int Test_Adjacent(int sensor, int mask)
{
  switch(sensor & mask)
  {
    //0 is allowed positions, 1 is not allowed
    case 0x40:
      if ((sensor & 0xAD) > 0) return 1; //mask: 1010 1101
      break;
      
    case 0x20:
      if ((sensor & 0xD5) > 0) return 1; //mask: 1101 0101
      break;
      
    case 0x10:
      if ((sensor & 0xA8) > 0) return 1; //mask: 1010 1000
      break;
      
    case 0x08:
      if ((sensor & 0xD0) > 0) return 1; //mask: 1101 0000
      break;
      
    case 0x04:
      if ((sensor & 0xE0) > 0) return 1; //mask: 1110 0000
      break;
      
    default:
        //something else is probably wrong if it reached this, so return error anyway
        return 1;
      break;
  }
  return 0;
}

//Add errors to the input signal based on the user input
int AddErrors(int sensor)
{
  //Goes through the ErrorSelectPanel and checks which bits to change
  //Each bit is changed as it's validated to get error injection
  //The comments next to the values notes which bit is changed
  if (getValue(NN_A))
    if (getValue(NN)) sensor |= 0x40; //0100 0000
    else sensor &= 0xBF;              //1011 1111
  if (getValue(UU_A))
    if (getValue(UU)) sensor |= 0x20; //0010 0000
    else sensor &= 0xDF;              //1101 1111
  if (getValue(N_A))
    if (getValue(N)) sensor |= 0x10;  //0001 0000
    else sensor &= 0xEF;              //1110 1111
  if (getValue(U_A)) 
    if (getValue(U)) sensor |= 0x08;  //0000 1000
    else sensor &= 0xF7;              //1111 0111
  if (getValue(C_A))
    if (getValue(C)) sensor |= 0x04;  //0000 0100
    else sensor &= 0xFB;              //1111 1011
  if (getValue(A_A))
    if (getValue(A)) sensor |= 0x02;  //0000 0010
    else sensor &= 0xFD;              //1111 1101
  if (getValue(M_A))
    if (getValue(M)) sensor |= 0x01;  //0000 0001
    else sensor &= 0xFE;              //1111 1110
  
  return sensor;
}

//Evaluates MakeBeforeBreak on the input value
//Input value should be in format:
//7:0, 6:--, 5:++, 4:-, 3:+, 2:C, 1:A, 0:M
//0 NN UU N U C A M
void MBB(int sensor_status)
{ 
  /*examine code*/
  write("%s%s", bits[sensor_status>>4], bits[sensor_status&0xf] );
  /*******************************************************************
    Change the background before altering the signal
  *******************************************************************/
  ChangeBackground(sensor_status);
  /*******************************************************************
    Add user specified errors to the sensor value
  *******************************************************************/
  sensor_status = AddErrors(sensor_status);
  
  /*******************************************************************
    Evaluate Make Before Break on the possibly error injected value
  *******************************************************************/
  
  //Rule 1: At least 1 sensor active (excluding A/M)
  //Rule 2: No more than 2 sensors active at any point (excluding A/M)
  _sensors_active = 0;
  for(i = 0; i < 5; i++)
    if ( (((sensor_status >> 2) >> i) & 0x1) == 1)
      _sensors_active++; // count the number of active sensors
    
  //Rule 1
  if (!_sensors_active) //No active sensor
    _found_error[0] = 1;
    
  //Rule 2
  if (_sensors_active > 2) //More than 2 active sensors
    _found_error[1] = 1;
  
  //Rule 3: Only 2 adjacent sensors can be active
  _non_adjacent_active = 0;
  for (i = 0; i < 6; i++)
    if( (sensor_status & (0x80 >> i)) == (0x80 >> i) ) //Enter on first 1 in the sensor values i.e. 0(this->)1010010
    {
      _non_adjacent_active = Test_Adjacent(sensor_status, (0x80 >> i));
      break; //break out of for loop to skip looking at the other 1s, looking at the first is enough
    }
      
  if (_non_adjacent_active == 1) //If a non adjacent sensor is found active a rule is broken
    _found_error[2] = 1;
  
  //Rule 4: 2 signal franks between every adjacent position
  if ( sensor_status != _last_position)
  {
    //Enter if the value changed since the last time
    //If the last value didn't appear at least twice, a rule was broken
    if (_repeated < 1)
      _found_error[3] = 1;
    _repeated = 0;
    _last_move = _last_position; //Save the last movement of the magnet / sensor shift
  }
  else _repeated++; //Keep track of how many times the message have been sent in a row
  
  
  //Rule 5: Sensor activation must follow mechanical patterns
  _matched_pattern = 0;
  for (i = 0; i < 15; i++)
    if (_legal_patterns[i][0] == sensor_status) //Look through the matrix to find the message
      for (j = 0; j < 4; j++)
        if (_legal_patterns[i][j] == _last_move) //See if the movement is in the list of allowed moves
          _matched_pattern++;
        
  if(!_matched_pattern)
  {
    _found_error[4] = 1;
    write("(%d/%d)", sensor_status, _last_move);
  }

  _last_position = sensor_status;
  
  /*******************************************************************
    Update Interface
  *******************************************************************/
  ChangeDisplaySensors(sensor_status);
  SetMBBErrors(_found_error);
  for(i = 0; i < 5; i++) _found_error[i] = 0; //Reset the error array for the next time
}
