/*@!Encoding:1252*/
includes
{
  #include "..\source_files\MakeBeforeBreak.cin"
}

variables
{
  message EgsmToVddmPropDiagResFrame res;
  message EgsmToVddmPropDiagResFrame req;
  int res_data;
  int sensor_status;
  int last_value;
}


on start
{
  
}
/*
//Tar emot diagnosmeddelanden från växelspaken
on message EgsmToVddmPropDiagResFrame
{
  res_data = this.data1;
  if (this.praise_the_sun != 0x62) return;
  sensor_status = 0;
  //write("%d", timeNow()/100);
  
  sensor_status |= (res_data & 0x10) >> 4;
  sensor_status |= (res_data & 0x08) >> 2;
  sensor_status |= (res_data & 0x04) << 2;
  sensor_status |= (res_data & 0x02) << 1;
  sensor_status |= (res_data & 0x01) << 3;
  
  MBB(sensor_status);
}
*/

on envVar shift_up
{
  if (getValue(gear) > 1) putValue(gear, getValue(gear) - 0xA);
}

on envVar shift_down
{
  if (getValue(gear) < 999) putValue(gear, getValue(gear) + 0xA);
}

//Testkod nedan
on key '5'
{
  write("Pressed key: %c", this);
  MBB(0x06); //AC
  last_value = 0x06;
}
on key '4'
{
  write("Pressed key: %c", this);
  MBB(0x0E); //AC -> +
  last_value = 0x0E;
}
on key '3'
{
  write("Pressed key: %c", this);
  MBB(0x0A); //+
  last_value = 0x0A;
}
on key '2'
{
  write("Pressed key: %c", this);
  MBB(0x2A); //+ -> ++
  last_value = 0x2A;
}
on key '1'
{
  write("Pressed key: %c", this);
  MBB(0x22); //++
  last_value = 0x22;
}
on key '6'
{
  write("Pressed key: %c", this);
  MBB(0x16); //AC -> -
  last_value = 0x16;
}
on key '7'
{
  write("Pressed key: %c", this);
  MBB(0x12); //-
  last_value = 0x12;
}
on key '8'
{
  write("Pressed key: %c", this);
  MBB(0x52); //- -> --
  last_value = 0x52;
}
on key '9'
{
  write("Pressed key: %c", this);
  MBB(0x42); //--
  last_value = 0x42;
}
on key 'q'
{
  write("Pressed key: %c", this);
  MBB(0x07); //A -> M / M -> A
  last_value = 0x07;
}
on key 't'
{
  write("Pressed key: %c", this);
  MBB(0x05); //MC
  last_value = 0x05;
}
on key 'y'
{
  write("Pressed key: %c", this);
  MBB(0x0D); //MC -> +
  last_value = 0x0D;
}
on key 'u'
{
  write("Pressed key: %c", this);
  MBB(0x09); //M+
  last_value = 0x09;
}
on key 'r'
{
  write("Pressed key: %c", this);
  MBB(0x15); //MC -> -
  last_value = 0x15;
}
on key 'e'
{
  write("Pressed key: %c", this);
  MBB(0x11); //M-
  last_value = 0x11;
}
on key '0'
{
  write("Pressed key: %c", this);
  MBB(0x01); //no sensor active
  last_value = 0x01;
}