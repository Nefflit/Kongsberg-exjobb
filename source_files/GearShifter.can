/*@!Encoding:1252*/
includes
{
  #include "..\source_files\MakeBeforeBreak.cin"
}

variables
{
  int ind;
  int Shiftstep;
  int shift_end_value;
  int virtual_sensor_value;
  int step_count;
  int shifter_mode_value;
  int shifter_state;
  int standby_value;
  const int measure_signal_cycle = 1; //cycle time in ms for the state read
  const int stop_delay = 350; //the delay time where it waits in a forced position before returning to standby
  msTimer waitdown_Time;
  msTimer waitup_Time;
  msTimer timer_down;
  msTimer timer_up;
  msTimer timer_mode_auto;
  msTimer timer_mode_man;
  msTimer measure_signal;
}
on start
{
  // Calculates the number of positions for the shifter
  // and how long the distance is between two positions.
  //
  // Based on the number of sensors on the simulated shifter.
  step_count = 2*getValue(Sensor_Counter) - 1;
  Shiftstep = (1000/step_count);
  standby_value = getValue(Gear_Shift);
  
  setTimerCyclic(measure_signal, measure_signal_cycle); //start the simulator
  enableControl("GearShifter", "Button_Automatic", 0);
}
on envVar Sensor_Counter
{
  // Update the position count and distance when the number of sensors change
  step_count = 2*getValue(Sensor_Counter) - 1;
  Shiftstep = (1000/step_count);
}

on envVar Gear_Down
{
  //exit on events when the envVar turned 0
  if (!getValue(this)) return;
  //exit without doing anything if shifter is in manual and it's not 
  //in an idle position
  if (0 <= shifter_mode_value && shifter_mode_value <= 100)
    if (standby_value != getValue(Gear_Shift)) return;
    
  shift_end_value = getValue(Gear_Shift) + Shiftstep*2;
  
  if(getValue(Gear_Shift) < 999)
    setTimerCyclic(timer_down, 10);
}
on envVar Gear_up
{
  //exit on events when the envVar turned 0
  if (!getValue(this)) return;
  //exit without doing anything if shifter is in manual and it's not 
  //in an idle position
  if (0 <= shifter_mode_value && shifter_mode_value <= 100)
    if (standby_value != getValue(Gear_Shift)) return;
    
  shift_end_value = getValue(Gear_Shift) - Shiftstep*2;
  
  if(getValue(Gear_Shift) > 1)
    setTimerCyclic(timer_up, 10);
}
on envVar Mode_Auto
{
  if (!getValue(this)) return;
  setTimerCyclic(timer_mode_man, 20);
}
on envVar Mode_Man
{
  if (!getValue(this)) return;
  setTimerCyclic(timer_mode_auto, 20);
}

on timer timer_down
{
  putValue(Gear_Shift, getValue(Gear_Shift) + Shiftstep/6);
  if(getValue(Gear_Shift) >= 1000 || shift_end_value <= getValue(Gear_Shift))
  {
    cancelTimer(this);
    //while (getValue(Gear_Down)) ; // Remain at the edge of a shift as long as the button is pressed
    setTimer(waitdown_Time, stop_delay);
  }
}
on timer timer_up
{
  putValue(Gear_Shift, getValue(Gear_Shift) - Shiftstep/6);
  if(getValue(Gear_Shift) <= 0 || shift_end_value >= getValue(Gear_Shift))
  {
    cancelTimer(this);
    //while (getValue(Gear_up)) ; // Remain at the edge of a shift as long as the button is pressed
    setTimer(waitup_Time, stop_delay);
  }
}
on timer timer_mode_auto
{
  putValue(Mode_shift, getValue(Mode_shift) - 40);
  if (getValue(Mode_shift) <= 40)
  {
    enableControl("GearShifter", "Button_Manual", 0);
    enableControl("GearShifter", "Button_Automatic", 1);
    cancelTimer(this);
  }
}
on timer timer_mode_man
{
  putValue(Mode_shift, getValue(Mode_shift) + 40);
  if (getValue(Mode_shift) >= 260)
  {
    enableControl("GearShifter", "Button_Manual", 1);
    enableControl("GearShifter", "Button_Automatic", 0);
    cancelTimer(this);
  }
}

on timer waitdown_Time
{
  putValue(Gear_Shift, getValue(Gear_Shift) - 50);
  if (getValue(Gear_Shift) > 500)
    setTimer(waitdown_Time, 5);
  else standby_value = getValue(Gear_Shift);
}
on timer waitup_Time
{
  putValue(Gear_Shift, getValue(Gear_Shift) + 50);
  if (getValue(Gear_Shift) < 500)
    setTimer(waitup_Time, 5);
  else standby_value = getValue(Gear_Shift);
}

on timer measure_signal
{
  virtual_sensor_value = getValue(Gear_Shift);
  shifter_mode_value = getValue(Mode_shift);
  
  //calculate which sensors of the automatic/manual sensors that are active
  if (0 <= shifter_mode_value && shifter_mode_value <= 100) shifter_state = 0x1;
  else if (100 < shifter_mode_value && shifter_mode_value <= 200) shifter_state = 0x3;
  else shifter_state = 0x2;
  
  for (ind = 0; ind < step_count; ind++)
  {
    if (Shiftstep * ind <= virtual_sensor_value && virtual_sensor_value < Shiftstep * (ind+1))
    {
      if (step_count == 5)
      {
        switch(ind)
        {
          case 0:
            MBB(0x08 | shifter_state);//UPP
            break;
          case 1:
            MBB(0x0C | shifter_state);//UPP-CENTER
            break;
          case 2:
            MBB(0x04 | shifter_state);//CENTER
            break;
          case 3:
            MBB(0x14 | shifter_state);//CENTER-DOWN
            break;
          case 4:
            MBB(0x10 | shifter_state);//DOWN
            break;
          default:
            //something went horribly wrong if the program entered here :[
            //print out a warning and leave
            write("Invalid code for MBB shift simulator.");
            break;
        }
      }
      else if (step_count == 9)
      {
        switch(ind)
        {
          case 0:
            MBB(0x22);//UP-UP
            break;
          case 1:
            MBB(0x2A);//UP->UP-UP
            break;
          case 2:
            MBB(0x08 | shifter_state);//UP
            break;
          case 3:
            MBB(0x0C | shifter_state);//UP->CENTER
            break;
          case 4:
            MBB(0x04 | shifter_state);//CENTER
            break;
          case 5:
            MBB(0x14 | shifter_state);//CENTER->DOWN
            break;
          case 6:
            MBB(0x10 | shifter_state);//DOWN
            break;
          case 7:
            MBB(0x52);//DOWN->DOWN-DOWN
            break;
          case 8:
            MBB(0x42);//DOWN-DOWN
            break;
          default:
            //something went horribly wrong if the program entered here :[
            //print out a warning and leave
            write("Invalid code for MBB shift simulator.");
            break;
        }
      }
      else
        MBB(0x06);
    }
  }
}
