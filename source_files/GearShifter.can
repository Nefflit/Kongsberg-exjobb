/*@!Encoding:1252*/
includes
{
  
}

variables
{
  int i;
  msTimer waitdown_Time;
  msTimer waitup_Time;
  msTimer timerdown;
  msTimer timerup;
}

on envVar Gear_Down
{
  if(getValue(Gear_Shift) < 999)
    putValue(Gear_Shift, getValue(Gear_Shift) + 50);
    setTimerCyclic(timerdown, 1);
}

on envVar Gear_up
{
  if(getValue(Gear_Shift) > 1)
    putValue(Gear_Shift, getValue(Gear_Shift) - 50);
    setTimerCyclic(timerup, 1);
}

on timer timerdown
{
  putValue(Gear_Shift, getValue(Gear_Shift) + 60);
  if(getValue(Gear_Shift) >= 700)
  {
    setTimer(waitdown_Time, 300);
    cancelTimer(timerdown);
  }
}

on timer timerup
{
  putValue(Gear_Shift, getValue(Gear_Shift) - 60);
  if(getValue(Gear_Shift) <= 300)
  {
    setTimer(waitup_Time, 300);
    cancelTimer(timerup);
  }
}

on timer waitdown_Time
{
  for(i = getValue(Gear_Shift); i >= 500; i-=50 )
      putValue(Gear_Shift, getValue(Gear_Shift) - 50);
}

on timer waitup_Time
{
  for(i = getValue(Gear_Shift); i <= 500; i+=50 )
      putValue(Gear_Shift, getValue(Gear_Shift) + 50);
}



