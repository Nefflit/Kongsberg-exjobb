/*@!Encoding:1252*/
includes
{
  
}

variables
{
  int i;
  int Shiftstep;
  msTimer waitdown_Time;
  msTimer waitup_Time;
  msTimer timerdown;
  msTimer timerup;
}
on start
{
  Shiftstep = (1000/(2*getValue(Sensor_Counter) - 1));
}
on envVar Sensor_Counter
{
  Shiftstep = (1000/(2*getValue(Sensor_Counter) - 1));
  write("%d", Shiftstep);
}

on envVar Gear_Down
{
  if (!getValue(Gear_Down)) return;
  
  if(getValue(Gear_Shift) < 999)
    setTimerCyclic(timerdown, 10);
}

on envVar Gear_up
{
  if (!getValue(Gear_up)) return;
  
  if(getValue(Gear_Shift) > 1)
    setTimerCyclic(timerup, 10);
}

on timer timerdown
{
  putValue(Gear_Shift, getValue(Gear_Shift) + Shiftstep/4);
  if(getValue(Gear_Shift) >= 1000)
  {
    setTimer(waitdown_Time, 300);
    cancelTimer(timerdown);
  }
}

on timer timerup
{
  putValue(Gear_Shift, getValue(Gear_Shift) - Shiftstep/4);
  if(getValue(Gear_Shift) <= 0)
  {
    setTimer(waitup_Time, 300);
    cancelTimer(timerup);
  }
}

on timer waitdown_Time
{
  for(i = getValue(Gear_Shift); i >= 500; i-=50 )
      putValue(Gear_Shift, getValue(Gear_Shift) - 50);
}

on timer waitup_Time
{
  for(i = getValue(Gear_Shift); i <= 500; i+=50 )
      putValue(Gear_Shift, getValue(Gear_Shift) + 50);
}