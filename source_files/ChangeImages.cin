/*@!Encoding:1252*/
includes
{
  
}

variables
{
  
}

void ChangeBackground(int background)
{
  switch (background)
  {
    case 0x05:
    case 0x06:  setPictureBoxImage("sensorPanel", "sensorBackground", "..\\images\\N.png");  break;
    case 0x15:
    case 0x16:  setPictureBoxImage("sensorPanel", "sensorBackground", "..\\images\\N2R.png");  break;
    case 0x11:
    case 0x12:  setPictureBoxImage("sensorPanel", "sensorBackground", "..\\images\\R.png");  break;
    case 0x52:  setPictureBoxImage("sensorPanel", "sensorBackground", "..\\images\\R2--.png");  break;
    case 0x42:  setPictureBoxImage("sensorPanel", "sensorBackground", "..\\images\\--.png");  break;
    case 0x0D:
    case 0x0E:  setPictureBoxImage("sensorPanel", "sensorBackground", "..\\images\\N2D.png");  break;
    case 0x09:
    case 0x0A:  setPictureBoxImage("sensorPanel", "sensorBackground", "..\\images\\D.png");  break;
    case 0x2A:  setPictureBoxImage("sensorPanel", "sensorBackground", "..\\images\\D2++.png");  break;
    case 0x22:  setPictureBoxImage("sensorPanel", "sensorBackground", "..\\images\\++.png");  break;    
  }
}

//Updates the display sensors on screen to the new active states
void ChangeDisplaySensors(int sensors)
{
  if (sensors & 0x40) setPictureBoxImage("sensorPanel", "NN", "..\\images\\ActiveSensor.png");
  else setPictureBoxImage("sensorPanel", "NN", "..\\images\\InactiveSensor.png");
  
  if (sensors & 0x20) setPictureBoxImage("sensorPanel", "UU", "..\\images\\ActiveSensor.png");
  else setPictureBoxImage("sensorPanel", "UU", "..\\images\\InactiveSensor.png");
  
  if (sensors & 0x10) setPictureBoxImage("sensorPanel", "N", "..\\images\\ActiveSensor.png");
  else setPictureBoxImage("sensorPanel", "N", "..\\images\\InactiveSensor.png");
  
  if (sensors & 0x08) setPictureBoxImage("sensorPanel", "U", "..\\images\\ActiveSensor.png");
  else setPictureBoxImage("sensorPanel", "U", "..\\images\\InactiveSensor.png");
  
  if (sensors & 0x04) setPictureBoxImage("sensorPanel", "C", "..\\images\\ActiveSensor.png");
  else setPictureBoxImage("sensorPanel", "C", "..\\images\\InactiveSensor.png");
  
  if (sensors & 0x02) setPictureBoxImage("sensorPanel", "A", "..\\images\\ActiveSensor.png");
  else setPictureBoxImage("sensorPanel", "A", "..\\images\\InactiveSensor.png");
  
  if (sensors & 0x01) setPictureBoxImage("sensorPanel", "M", "..\\images\\ActiveSensor.png");
  else setPictureBoxImage("sensorPanel", "M", "..\\images\\InactiveSensor.png");
}

//Reset the background images in the MBBError panel for the next test
void SetMBBErrors(int found[])
{
  if (found[0]) setPictureBoxImage("MBBRules", "rule1", "..\\images\\error1.png");
  else setPictureBoxImage("MBBRules", "rule1", "..\\images\\okay1.png");
  
  if (found[1]) setPictureBoxImage("MBBRules", "rule2", "..\\images\\error2.png");
  else setPictureBoxImage("MBBRules", "rule2", "..\\images\\okay2.png");
  
  if (found[2]) setPictureBoxImage("MBBRules", "rule3", "..\\images\\error3.png");
  else setPictureBoxImage("MBBRules", "rule3", "..\\images\\okay3.png");
  
  if (found[3]) setPictureBoxImage("MBBRules", "rule4", "..\\images\\error4.png");
  else setPictureBoxImage("MBBRules", "rule4", "..\\images\\okay4.png");
  
  if (found[4]) setPictureBoxImage("MBBRules", "rule5", "..\\images\\error5.png");
  else setPictureBoxImage("MBBRules", "rule5", "..\\images\\okay5.png");
  
}