/*@!Encoding:1252*/
includes
{
  
}

variables
{
  int oldRule1 = 0, oldRule2 = 0, oldRule3 = 0, oldRule4 = 0, oldRule5 = 0;
  int old_shift_state;
  int old_state[5];
}

void ChangeBackground(int background)
{
  //Each case represents a single background with a few fall-through cases for manual shifting
  switch (background)
  {
    case 0x05:
    case 0x06:  setPictureBoxImage("sensorPanel", "sensorBackground", "..\\images\\N.png");  break;
    case 0x15:
    case 0x16:  setPictureBoxImage("sensorPanel", "sensorBackground", "..\\images\\N2R.png");  break;
    case 0x11:
    case 0x12:  setPictureBoxImage("sensorPanel", "sensorBackground", "..\\images\\R.png");  break;
    case 0x52:  setPictureBoxImage("sensorPanel", "sensorBackground", "..\\images\\R2--.png");  break;
    case 0x42:  setPictureBoxImage("sensorPanel", "sensorBackground", "..\\images\\--.png");  break;
    case 0x0D:
    case 0x0E:  setPictureBoxImage("sensorPanel", "sensorBackground", "..\\images\\N2D.png");  break;
    case 0x09:
    case 0x0A:  setPictureBoxImage("sensorPanel", "sensorBackground", "..\\images\\D.png");  break;
    case 0x2A:  setPictureBoxImage("sensorPanel", "sensorBackground", "..\\images\\D2++.png");  break;
    case 0x22:  setPictureBoxImage("sensorPanel", "sensorBackground", "..\\images\\++.png");  break;    
  }
}

//Updates the display sensors on screen to the new active states
void ChangeDisplaySensors(int sensors)
{
  //Each if-statements test if the (value & mask) return a 1 to find which sensors are active or not
  //then set the appropriate image for the result
  if (sensors & 0x40) setPictureBoxImage("sensorPanel", "NN", "..\\images\\ActiveSensor.png");
  else setPictureBoxImage("sensorPanel", "NN", "..\\images\\InactiveSensor.png");
  
  if (sensors & 0x20) setPictureBoxImage("sensorPanel", "UU", "..\\images\\ActiveSensor.png");
  else setPictureBoxImage("sensorPanel", "UU", "..\\images\\InactiveSensor.png");
  
  if (sensors & 0x10) setPictureBoxImage("sensorPanel", "N", "..\\images\\ActiveSensor.png");
  else setPictureBoxImage("sensorPanel", "N", "..\\images\\InactiveSensor.png");
  
  if (sensors & 0x08) setPictureBoxImage("sensorPanel", "U", "..\\images\\ActiveSensor.png");
  else setPictureBoxImage("sensorPanel", "U", "..\\images\\InactiveSensor.png");
  
  if (sensors & 0x04) setPictureBoxImage("sensorPanel", "C", "..\\images\\ActiveSensor.png");
  else setPictureBoxImage("sensorPanel", "C", "..\\images\\InactiveSensor.png");
  
  if (sensors & 0x02) setPictureBoxImage("sensorPanel", "A", "..\\images\\ActiveSensor.png");
  else setPictureBoxImage("sensorPanel", "A", "..\\images\\InactiveSensor.png");
  
  if (sensors & 0x01) setPictureBoxImage("sensorPanel", "M", "..\\images\\ActiveSensor.png");
  else setPictureBoxImage("sensorPanel", "M", "..\\images\\InactiveSensor.png");
}

//Prints out which position the shifter is expected to be in
void WriteShifterState(int state)
{
  if (old_shift_state != state)
  {
    deleteControlContent("sensorPanel", "outputText");
    switch (state)
    {
      case 0x05: putValueToControl("sensorPanel", "outputText", "Shifter is in manual at C.\n"); break;
      case 0x06: putValueToControl("sensorPanel", "outputText", "Shifter is in automatic at C.\n"); break;
      case 0x07: putValueToControl("sensorPanel", "outputText", "Shifter is between automtic and manual.\n"); break;
      case 0x15: putValueToControl("sensorPanel", "outputText", "Shifter is in manual between C and D.\n"); break;
      case 0x16: putValueToControl("sensorPanel", "outputText", "Shifter is in automatic between C and D.\n"); break;
      case 0x11: putValueToControl("sensorPanel", "outputText", "Shifter is in manual at D.\n"); break;
      case 0x12: putValueToControl("sensorPanel", "outputText", "Shifter is in automatic at D.\n"); break;
      case 0x52: putValueToControl("sensorPanel", "outputText", "Shifter is in automatic between D and DD.\n"); break;
      case 0x42: putValueToControl("sensorPanel", "outputText", "Shifter is in automatic at DD.\n"); break;
      case 0x0D: putValueToControl("sensorPanel", "outputText", "Shifter is in manual between C and U.\n"); break;
      case 0x0E: putValueToControl("sensorPanel", "outputText", "Shifter is in automatic between C and U\n"); break;
      case 0x09: putValueToControl("sensorPanel", "outputText", "Shifter is in manual at U.\n"); break;
      case 0x0A: putValueToControl("sensorPanel", "outputText", "Shifter is in automatic at U.\n"); break;
      case 0x2A: putValueToControl("sensorPanel", "outputText", "Shifter is in automatic between U and UU.\n"); break;
      case 0x22: putValueToControl("sensorPanel", "outputText", "Shifter is in automatic at UU.\n"); break;
      //default state should never happen, so write and error message
      default: write("***ERROR: WriteShifterState recived invalid value"); break;
    }
    old_shift_state = state;
  }
}

//Reset the background images in the MBBError panel for the next test
void SetMBBErrors(int state, int found[])
{
  //Remove the text in the output textbox if last time set the text to anything
  for(i = 0; i < 5; i++) 
    if (old_state[i] != found[i])//only reset if a rule-value is different from last time
    { 
      deleteControlContent("sensorPanel", "outputText");//remove everything from the output textbox
      oldRule1 = 0; oldRule2 = 0; oldRule3 = 0; oldRule4 = 0; oldRule5 = 0;
      WriteShifterState(state); //do anoter call to WriteShifterState since we deleted the last value
      break; //Doing anything with outputText is costly, so avoid it if more than 1 changed place
    }
   
  if (found[0]) 
  {
    //if it found an error for [0] set rule 1 to broken and output the correct text to the textbox
    setPictureBoxImage("MBBRules", "rule1", "..\\images\\error1.png");
    if (!oldRule1)//make sure the text isn't already displayed in the text after the potential reset, if it is don't output it again
    {
      putValueToControl("sensorPanel", "outputText", "Rule 1 broken:\nThere is no sensor active of the positional sensors!\n\n");
      oldRule1 = 1;
    }
  }
  else 
  {
    //otherwise just set the rule background to okay and try the next
    setPictureBoxImage("MBBRules", "rule1", "..\\images\\okay1.png");
    oldRule1 = 0;
  }
  //see found[0] for information on found[1] -> found[4]
  if (found[1])
  {
    setPictureBoxImage("MBBRules", "rule2", "..\\images\\error2.png");
    if (!oldRule2)
    {
      putValueToControl("sensorPanel", "outputText", "Rule 2 broken:\nOnly two sensors can be active at any time!\n\n");
      oldRule2 = 1;
    }
  }
  else 
  {
    setPictureBoxImage("MBBRules", "rule2", "..\\images\\okay2.png");
    oldRule2 = 0;
  }
  
  if (found[2])
  {
    setPictureBoxImage("MBBRules", "rule3", "..\\images\\error3.png");
    if (!oldRule3)
    {
      putValueToControl("sensorPanel", "outputText", "Rule 3 broken:\nThe sensors active are not adjacent to each other!\n\n");
      oldRule3 = 1;
    }
  }
  else 
  {
    setPictureBoxImage("MBBRules", "rule3", "..\\images\\okay3.png");
    oldRule3 = 0;
  }
  
  if (found[3])
  {
    setPictureBoxImage("MBBRules", "rule4", "..\\images\\error4.png");
    if (!oldRule4)
    {
      putValueToControl("sensorPanel", "outputText", "Rule 4 broken:\nNot enough time passed between two movements!\n\n");
      oldRule4 = 1;
    }
  }
  else
  {
    setPictureBoxImage("MBBRules", "rule4", "..\\images\\okay4.png");
    oldRule4 = 0;
  }
  
  if (found[4])
  {
    setPictureBoxImage("MBBRules", "rule5", "..\\images\\error5.png");
    if (!oldRule5)
    {
      putValueToControl("sensorPanel", "outputText", "Rule 5 broken:\nThis is not a combination of moves that is possible by hardware limitations!");
      oldRule5 = 1;
    }
  }
  else
  {
    setPictureBoxImage("MBBRules", "rule5", "..\\images\\okay5.png");
    oldRule5 = 0;
  }
  
  for(i = 0; i < 5; i++) old_state[i] = found[i];//Save the last state for next time
}