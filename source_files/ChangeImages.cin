/*@!Encoding:1252*/
includes
{
  
}

variables
{
  int oldRule1 = 0, oldRule2 = 0, oldRule3 = 0, oldRule4 = 0, oldRule5 = 0;
  int old_shift_state;
  int shifter_state_displayed = 0;
  int old_state[5];
}

void ChangeBackground(int background)
{
  //Each case represents a single background with a few fall-through cases for manual shifting
  switch (background)
  {
    case 0x05:  
      setPictureBoxImage("sensorPanel", "magnet_m", "..\\images\\magnet.png");
      setPictureBoxImage("sensorPanel", "magnet_am", "..\\images\\empty.png");
      setPictureBoxImage("sensorPanel", "sensorBackground", "..\\images\\N.png");
      break;
    case 0x06:
      setPictureBoxImage("sensorPanel", "magnet_a", "..\\images\\magnet.png");
      setPictureBoxImage("sensorPanel", "magnet_am", "..\\images\\empty.png");
      setPictureBoxImage("sensorPanel", "sensorBackground", "..\\images\\N.png");  
      break;
    case 0x07:
      setPictureBoxImage("sensorPanel", "magnet_m", "..\\images\\empty.png");
      setPictureBoxImage("sensorPanel", "magnet_a", "..\\images\\empty.png");
      setPictureBoxImage("sensorPanel", "magnet_am", "..\\images\\magnet.png");
      setPictureBoxImage("sensorPanel", "sensorBackground", "..\\images\\N.png");
      break;
    case 0x15:
    case 0x16:  setPictureBoxImage("sensorPanel", "sensorBackground", "..\\images\\N2R.png");  break;
    case 0x11:
    case 0x12:  setPictureBoxImage("sensorPanel", "sensorBackground", "..\\images\\R.png");  break;
    case 0x52:  setPictureBoxImage("sensorPanel", "sensorBackground", "..\\images\\R2--.png");  break;
    case 0x42:  setPictureBoxImage("sensorPanel", "sensorBackground", "..\\images\\--.png");  break;
    case 0x0D:
    case 0x0E:  setPictureBoxImage("sensorPanel", "sensorBackground", "..\\images\\N2D.png");  break;
    case 0x09:
    case 0x0A:  setPictureBoxImage("sensorPanel", "sensorBackground", "..\\images\\D.png");  break;
    case 0x2A:  setPictureBoxImage("sensorPanel", "sensorBackground", "..\\images\\D2++.png");  break;
    case 0x22:  setPictureBoxImage("sensorPanel", "sensorBackground", "..\\images\\++.png");  break;    
  }
}

//Updates the display sensors on screen to the new active states
void ChangeDisplaySensors(int sensors, int with_errors)
{
  //Each if-statements test if the (value & mask) return a 1 to find which sensors are active or not
  //then set the appropriate image for the result
  if (sensors & 0x40) setPictureBoxImage("sensorPanel", "NN", "..\\images\\ActiveSensor.png");
  else if (with_errors & 0x40) setPictureBoxImage("sensorPanel", "NN", "..\\images\\FaultySensor.png");
  else setPictureBoxImage("sensorPanel", "NN", "..\\images\\InactiveSensor.png");
  
  if (sensors & 0x20) setPictureBoxImage("sensorPanel", "UU", "..\\images\\ActiveSensor.png");
  else if (with_errors & 0x20) setPictureBoxImage("sensorPanel", "UU", "..\\images\\FaultySensor.png");
  else setPictureBoxImage("sensorPanel", "UU", "..\\images\\InactiveSensor.png");
  
  if (sensors & 0x10) setPictureBoxImage("sensorPanel", "N", "..\\images\\ActiveSensor.png");
  else if (with_errors & 0x10) setPictureBoxImage("sensorPanel", "N", "..\\images\\FaultySensor.png");
  else setPictureBoxImage("sensorPanel", "N", "..\\images\\InactiveSensor.png");
  
  if (sensors & 0x08) setPictureBoxImage("sensorPanel", "U", "..\\images\\ActiveSensor.png");
  else if (with_errors & 0x08) setPictureBoxImage("sensorPanel", "U", "..\\images\\FaultySensor.png");
  else setPictureBoxImage("sensorPanel", "U", "..\\images\\InactiveSensor.png");
  
  if (sensors & 0x04) setPictureBoxImage("sensorPanel", "C", "..\\images\\ActiveSensor.png");
  else if (with_errors & 0x04) setPictureBoxImage("sensorPanel", "C", "..\\images\\FaultySensor.png");
  else setPictureBoxImage("sensorPanel", "C", "..\\images\\InactiveSensor.png");
  
  if (sensors & 0x02) setPictureBoxImage("sensorPanel", "A", "..\\images\\ActiveSensor.png");
  else if (with_errors & 0x02) setPictureBoxImage("sensorPanel", "A", "..\\images\\FaultySensor.png");
  else setPictureBoxImage("sensorPanel", "A", "..\\images\\InactiveSensor.png");
  
  if (sensors & 0x01) setPictureBoxImage("sensorPanel", "M", "..\\images\\ActiveSensor.png");
  else if (with_errors & 0x01) setPictureBoxImage("sensorPanel", "M", "..\\images\\FaultySensor.png");
  else setPictureBoxImage("sensorPanel", "M", "..\\images\\InactiveSensor.png");
}

//Prints out which position the shifter is expected to be in
void WriteShifterState(int state)
{
  deleteControlContent("sensorPanel", "outputText");
  switch (state)
  {
    case 0x05: putValueToControl("sensorPanel", "outputText", "Magnets are in manual at C."); break;
    case 0x06: putValueToControl("sensorPanel", "outputText", "Magnets are in automatic at C."); break;
    case 0x07: putValueToControl("sensorPanel", "outputText", "Magnets are between automtic and manual."); break;
    case 0x15: putValueToControl("sensorPanel", "outputText", "Magnets are manual between C and D."); break;
    case 0x16: putValueToControl("sensorPanel", "outputText", "Magnets are in automatic between C and D."); break;
    case 0x11: putValueToControl("sensorPanel", "outputText", "Magnets are in manual at D."); break;
    case 0x12: putValueToControl("sensorPanel", "outputText", "Magnets are in automatic at D."); break;
    case 0x52: putValueToControl("sensorPanel", "outputText", "Magnets are in automatic between D and DD."); break;
    case 0x42: putValueToControl("sensorPanel", "outputText", "Magnets are in automatic at DD."); break;
    case 0x0D: putValueToControl("sensorPanel", "outputText", "Magnets are in manual between C and U."); break;
    case 0x0E: putValueToControl("sensorPanel", "outputText", "Magnets are in automatic between C and U."); break;
    case 0x09: putValueToControl("sensorPanel", "outputText", "Magnets are in manual at U."); break;
    case 0x0A: putValueToControl("sensorPanel", "outputText", "Magnets are in automatic at U."); break;
    case 0x2A: putValueToControl("sensorPanel", "outputText", "Magnets are in automatic between U and UU."); break;
    case 0x22: putValueToControl("sensorPanel", "outputText", "Magnets are in automatic at UU."); break;
    //default state should never happen, so write and error message
    default: write("***ERROR: WriteShifterState recived invalid value"); break;
  }
  putValueToControl("sensorPanel", "outputText", "\n\n");
  old_shift_state = state;
}

//Reset the background images in the MBBError panel for the next test
void FillOutputTextBox(int state, int found[])
{
  //Remove the text in the output textbox if last call set the text to anything
  for (i = 0; i < 5; i++) 
  {
    if (old_state[i] != found[i] || old_shift_state != state)//only reset if a rule-value is different from last time, or if shiter changed value
    { 
      deleteControlContent("sensorPanel", "outputText");//remove everything from the output textbox
      oldRule1 = 0; oldRule2 = 0; oldRule3 = 0; oldRule4 = 0; oldRule5 = 0;
      shifter_state_displayed = 0; //We cleared the output box, so shifter state isn't visible
      break; //Doing anything with outputText is costly, so avoid it if more than 1 changed place
    }
  }
  
  //Print the shifter state if the box is cleared or if the state changed
  if (!shifter_state_displayed)
  {
    WriteShifterState(state);
    shifter_state_displayed = 1;
  }
  if (found[0]) 
  {
    //if it found an error for [0] set rule 1 to broken and output the correct text to the textbox
    setPictureBoxImage("MBBRules", "rule1", "..\\images\\error1.png");
    if (!oldRule1)//make sure the text isn't already displayed in the text after the potential reset, if it is don't output it again
    {
      putValueToControl("sensorPanel", "outputText", "Rule 1 broken:\nThere is no sensor active of the positional sensors!\n\n");
      putValueToControl("logPanel", "logOutput", "Detected rule 1 broken.\n\n");
      oldRule1 = 1;
    }
  }
  else 
  {
    //otherwise just set the rule background to okay and try the next
    setPictureBoxImage("MBBRules", "rule1", "..\\images\\okay1.png");
    oldRule1 = 0;
  }
  //see found[0] for information on found[1] -> found[4]
  if (found[1])
  {
    setPictureBoxImage("MBBRules", "rule2", "..\\images\\error2.png");
    if (!oldRule2)
    {
      putValueToControl("sensorPanel", "outputText", "Rule 2 broken:\nOnly two sensors can be active at any time!\n\n");
      putValueToControl("logPanel", "logOutput", "Detected rule 2 broken.\n\n");
      oldRule2 = 1;
    }
  }
  else 
  {
    setPictureBoxImage("MBBRules", "rule2", "..\\images\\okay2.png");
    oldRule2 = 0;
  }
  
  if (found[2])
  {
    setPictureBoxImage("MBBRules", "rule3", "..\\images\\error3.png");
    if (!oldRule3)
    {
      putValueToControl("sensorPanel", "outputText", "Rule 3 broken:\nThe sensors active are not adjacent to each other!\n\n");
      putValueToControl("logPanel", "logOutput", "Detected rule 3 broken.\n\n");
      oldRule3 = 1;
    }
  }
  else 
  {
    setPictureBoxImage("MBBRules", "rule3", "..\\images\\okay3.png");
    oldRule3 = 0;
  }
  
  if (found[3])
  {
    setPictureBoxImage("MBBRules", "rule4", "..\\images\\error4.png");
    if (!oldRule4)
    {
      putValueToControl("sensorPanel", "outputText", "Rule 4 broken:\nNot enough time passed between two movements!\n\n");
      putValueToControl("logPanel", "logOutput", "Detected rule 4 broken.\n\n");
      oldRule4 = 1;
    }
  }
  else
  {
    setPictureBoxImage("MBBRules", "rule4", "..\\images\\okay4.png");
    oldRule4 = 0;
  }
  
  if (found[4])
  {
    setPictureBoxImage("MBBRules", "rule5", "..\\images\\error5.png");
    if (!oldRule5)
    {
      putValueToControl("sensorPanel", "outputText", "Rule 5 broken:\nThis is not a combination of moves that is possible by hardware limitations!");
      putValueToControl("logPanel", "logOutput", "Detected rule 5 broken.\n\n");
      oldRule5 = 1;
    }
  }
  else
  {
    setPictureBoxImage("MBBRules", "rule5", "..\\images\\okay5.png");
    oldRule5 = 0;
  }
  
  for (i = 0; i < 5; i++) old_state[i] = found[i];//Save the last state for next time
}

void LogAction(int state)
{
  switch (act)
  {
    case 1: putValueToControl("logPanel", "logOutput", "Shift up.\n\n"); break;
    case 2: putValueToControl("logPanel", "logOutput", "Shift down.\n\n"); break;
    case 3: putValueToControl("logPanel", "logOutput", "Shift automatic.\n\n"); break;
    case 4: putValueToControl("logPanel", "logOutput", "Shift manual.\n\n"); break;
    default: putValueToControl("logPanel", "logOutput", "***ERROR: Wrong input to LogAction().\n\n"); break;
  }
}