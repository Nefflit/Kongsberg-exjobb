/*@!Encoding:1252*/
includes
{
  
}

variables
{
  int oldRule1 = 0, oldRule2 = 0, oldRule3 = 0, oldRule4 = 0, oldRule5 = 0;
  int old_state[5];
}

void ChangeBackground(int background)
{
  switch (background)
  {
    case 0x05:
    case 0x06:  setPictureBoxImage("sensorPanel", "sensorBackground", "..\\images\\N.png");  break;
    case 0x15:
    case 0x16:  setPictureBoxImage("sensorPanel", "sensorBackground", "..\\images\\N2R.png");  break;
    case 0x11:
    case 0x12:  setPictureBoxImage("sensorPanel", "sensorBackground", "..\\images\\R.png");  break;
    case 0x52:  setPictureBoxImage("sensorPanel", "sensorBackground", "..\\images\\R2--.png");  break;
    case 0x42:  setPictureBoxImage("sensorPanel", "sensorBackground", "..\\images\\--.png");  break;
    case 0x0D:
    case 0x0E:  setPictureBoxImage("sensorPanel", "sensorBackground", "..\\images\\N2D.png");  break;
    case 0x09:
    case 0x0A:  setPictureBoxImage("sensorPanel", "sensorBackground", "..\\images\\D.png");  break;
    case 0x2A:  setPictureBoxImage("sensorPanel", "sensorBackground", "..\\images\\D2++.png");  break;
    case 0x22:  setPictureBoxImage("sensorPanel", "sensorBackground", "..\\images\\++.png");  break;    
  }
}

//Updates the display sensors on screen to the new active states
void ChangeDisplaySensors(int sensors)
{
  if (sensors & 0x40) setPictureBoxImage("sensorPanel", "NN", "..\\images\\ActiveSensor.png");
  else setPictureBoxImage("sensorPanel", "NN", "..\\images\\InactiveSensor.png");
  
  if (sensors & 0x20) setPictureBoxImage("sensorPanel", "UU", "..\\images\\ActiveSensor.png");
  else setPictureBoxImage("sensorPanel", "UU", "..\\images\\InactiveSensor.png");
  
  if (sensors & 0x10) setPictureBoxImage("sensorPanel", "N", "..\\images\\ActiveSensor.png");
  else setPictureBoxImage("sensorPanel", "N", "..\\images\\InactiveSensor.png");
  
  if (sensors & 0x08) setPictureBoxImage("sensorPanel", "U", "..\\images\\ActiveSensor.png");
  else setPictureBoxImage("sensorPanel", "U", "..\\images\\InactiveSensor.png");
  
  if (sensors & 0x04) setPictureBoxImage("sensorPanel", "C", "..\\images\\ActiveSensor.png");
  else setPictureBoxImage("sensorPanel", "C", "..\\images\\InactiveSensor.png");
  
  if (sensors & 0x02) setPictureBoxImage("sensorPanel", "A", "..\\images\\ActiveSensor.png");
  else setPictureBoxImage("sensorPanel", "A", "..\\images\\InactiveSensor.png");
  
  if (sensors & 0x01) setPictureBoxImage("sensorPanel", "M", "..\\images\\ActiveSensor.png");
  else setPictureBoxImage("sensorPanel", "M", "..\\images\\InactiveSensor.png");
}

//Reset the background images in the MBBError panel for the next test
void SetMBBErrors(int found[])
{
  for(i = 0; i < 5; i++) 
    if (old_state[i] != found[i])
    { 
      deleteControlContent("sensorPanel", "outputText");
      oldRule1 = 0; oldRule2 = 0; oldRule3 = 0; oldRule4 = 0; oldRule5 = 0;
      break; //Doing anything with outputText is costly, so avoid it if more than 1 changed place
    }
    
  if (found[0]) 
  {
    setPictureBoxImage("MBBRules", "rule1", "..\\images\\error1.png");
    if (!oldRule1)
    {
      putValueToControl("sensorPanel", "outputText", "Rule 1 broken:\nThere is no sensor active of the positional sensors!\n\n");
      oldRule1 = 1;
    }
  }
  else 
  {
    setPictureBoxImage("MBBRules", "rule1", "..\\images\\okay1.png");
    oldRule1 = 0;
  }
  
  if (found[1])
  {
    setPictureBoxImage("MBBRules", "rule2", "..\\images\\error2.png");
    if (!oldRule2)
    {
      putValueToControl("sensorPanel", "outputText", "Rule 2 broken:\nOnly two sensors can be active at any time!\n\n");
      oldRule2 = 1;
    }
  }
  else 
  {
    setPictureBoxImage("MBBRules", "rule2", "..\\images\\okay2.png");
    oldRule2 = 0;
  }
  
  if (found[2])
  {
    setPictureBoxImage("MBBRules", "rule3", "..\\images\\error3.png");
    if (!oldRule3)
    {
      putValueToControl("sensorPanel", "outputText", "Rule 3 broken:\nThe sensors active are not adjacent to each other!\n\n");
      oldRule3 = 1;
    }
  }
  else 
  {
    setPictureBoxImage("MBBRules", "rule3", "..\\images\\okay3.png");
    oldRule3 = 0;
  }
  
  if (found[3])
  {
    setPictureBoxImage("MBBRules", "rule4", "..\\images\\error4.png");
    if (!oldRule4)
    {
      putValueToControl("sensorPanel", "outputText", "Rule 4 broken:\nNot enough time passed between two movements!\n\n");
      oldRule4 = 1;
    }
  }
  else
  {
    setPictureBoxImage("MBBRules", "rule4", "..\\images\\okay4.png");
    oldRule4 = 0;
  }
  
  if (found[4])
  {
    setPictureBoxImage("MBBRules", "rule5", "..\\images\\error5.png");
    if (!oldRule5)
    {
      putValueToControl("sensorPanel", "outputText", "Rule 5 broken:\nThis is not a combination of moves that is possible by hardware limitations!");
      oldRule5 = 1;
    }
  }
  else
  {
    setPictureBoxImage("MBBRules", "rule5", "..\\images\\okay5.png");
    oldRule5 = 0;
  }
  
  for(i = 0; i < 5; i++) old_state[i] = found[i];//Save the last state for next time
}