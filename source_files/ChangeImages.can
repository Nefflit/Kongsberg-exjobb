/*@!Encoding:1252*/
includes
{
  
}

variables
{
  
}

void ChangeBackground(int background)
{
  switch (background)
  {
    case 0x06:  setPictureBoxImage("sensorPanel", "sensorBackground" , "..\\images\\N.png");  break;
    case 0x16:  setPictureBoxImage("sensorPanel", "sensorBackground" , "..\\images\\N2R.png");  break;
    case 0x12:  setPictureBoxImage("sensorPanel", "sensorBackground" , "..\\images\\R.png");  break;
    case 0x52:  setPictureBoxImage("sensorPanel", "sensorBackground" , "..\\images\\R2--.png");  break;
    case 0x42:  setPictureBoxImage("sensorPanel", "sensorBackground" , "..\\images\\--.png");  break;
    case 0x0E:  setPictureBoxImage("sensorPanel", "sensorBackground" , "..\\images\\N2D.png");  break;
    case 0x0A:  setPictureBoxImage("sensorPanel", "sensorBackground" , "..\\images\\D.png");  break;
    case 0x2A:  setPictureBoxImage("sensorPanel", "sensorBackground" , "..\\images\\D2++.png");  break;
    case 0x22:  setPictureBoxImage("sensorPanel", "sensorBackground" , "..\\images\\++.png");  break;    
  }
}

void ChangeDisplaySensors(int sensors)
{
  
}