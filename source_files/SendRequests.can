/*@!Encoding:1252*/
includes
{
  #include "..\source_files\MakeBeforeBreak.cin"
}

variables
{
  int sensor_status;
  int requests_failed;
  int sim_mode;
  int res;
 
  diagRequest ExtendedDiagnosticSession_Start EGSM_extended_session_start;
  diagRequest Hall_Sensors_Read EGSM_hall_req;
  diagRequest AGSM_sensor_position_Read AGSM_hall_req;
  byte hall_respBuffer[6];
}

on start
{
  if ( 0 == diagSetTarget("EGSM"))
      if ( diagSendRequest(EGSM_extended_session_start) > 0)
      {
        // Everything is fine unless it enters here
      }

}

//waits on responses xdr
on diagResponse EGSM.Classes::DIDs::Hall_Sensors_Read
{
  this.GetPrimitiveData(hall_respBuffer, 6);
  
  //data=0x0_: hall_respBuffer[3]
  //convert response to correct MBB input
  sensor_status = 0;
  //up and down are invertet for a more intuitive motion on-screen when shifting
  sensor_status |= (hall_respBuffer[3] & 0x10) >> 4;
  sensor_status |= (hall_respBuffer[3] & 0x08) >> 2;
  sensor_status |= (hall_respBuffer[3] & 0x04) << 2;
  sensor_status |= (hall_respBuffer[3] & 0x02) << 1;
  sensor_status |= (hall_respBuffer[3] & 0x01) << 3;
  
  MBB(sensor_status);
}
on diagResponse _952_AGSM_Automatic_Gearbox_Shifter_Module.Classes::EngeneeringParameters::AGSM_sensor_position_Read
{
  this.GetPrimitiveData(hall_respBuffer, 6);
  write("%x %x %x %x %x %x", hall_respBuffer[0],hall_respBuffer[1],hall_respBuffer[2],hall_respBuffer[3],hall_respBuffer[4],hall_respBuffer[5]);
  
  //TODO: convert bytes to MBB input
  sensor_status = 0;
  //WARNING: THE FOLLOWING CODE IS INCOMPLETE AND UNSAFE, DO NOT USE!
  //it assumes that the raw data is in hall_respBuffer for now
  sensor_status |= (hall_respBuffer[3]/*PLACEHOLDER*/ & 0x40) >> 6;
  sensor_status |= (hall_respBuffer[3]/*PLACEHOLDER*/ & 0x20) >> 4;
  sensor_status |= (hall_respBuffer[3]/*PLACEHOLDER*/ & 0x10) << 1;
  sensor_status |= (hall_respBuffer[3]/*PLACEHOLDER*/ & 0x08);
  sensor_status |= (hall_respBuffer[3]/*PLACEHOLDER*/ & 0x04);
  sensor_status |= (hall_respBuffer[3]/*PLACEHOLDER*/ & 0x02) << 3;
  sensor_status |= (hall_respBuffer[3]/*PLACEHOLDER*/ & 0x01) << 6;
  
  
  //MBB(sensor_status);
}
